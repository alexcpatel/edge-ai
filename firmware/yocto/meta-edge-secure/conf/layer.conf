## firmware/yocto/meta-edge-secure/conf/layer.conf
```bitbake
# Layer configuration for meta-edge-secure
# Custom layer for Edge AI secure device infrastructure

BBPATH .= ":${LAYERDIR}"
BBFILES += ""
BBFILE_COLLECTIONS += "meta-edge-secure"
BBFILE_PATTERN_meta-edge-secure = "^${LAYERDIR}/"
BBFILE_PRIORITY_meta-edge-secure = "10"

LAYERDEPENDS_meta-edge-secure = "core"
LAYERSERIES_COMPAT_meta-edge-secure = "scarthgap"

# Include all recipe directories
BBFILES += "${LAYERDIR}/recipes-*/*/*.bb"
BBFILES += "${LAYERDIR}/recipes-*/*/*.bbappend"
```
